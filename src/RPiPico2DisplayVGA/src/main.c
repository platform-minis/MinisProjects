// RPiPico2DisplayVGA — VGA terminal z klawiaturą PS/2
// Raspberry Pi Pico 2 (RP2350), 640×480 monochrome VGA + klawiatura PS/2.
//
// Biblioteka VGA : codaris/picovga-cmake v1.2.2
//   https://github.com/codaris/picovga-cmake/releases/tag/v1.2.2
//   commit: f2dc01f6990d81b08e9c31494325aced66f2e20d
//
// Biblioteka PS/2: lurk101/ps2kbd-lib
//   https://github.com/lurk101/ps2kbd-lib
//   commit: 9ef20df0bfded1d8fdddbb8b864202224c7faf50
//
// Hardware — Waveshare VGA PS2 Board (rezystory DAC i złącza wbudowane):
//
//   Pico 2   16BitI/O   Sygnał
//   GP0  ──► pin 19  ── VGA_R0
//   GP1  ──► pin 17  ── VGA_R1
//   GP2  ──► pin 15  ── VGA_R2
//   GP3  ──► pin 13  ── VGA_G0
//   GP4  ──► pin 14  ── VGA_G1
//   GP5  ──► pin 11  ── VGA_G2
//   GP6  ──► pin 20  ── VGA_B0
//   GP7  ──► pin 18  ── VGA_B1
//   GP8  ──► pin 7   ── HSYNC
//   GP9  ──► pin 8   ── VSYNC
//   GP20 ──► pin 5   ── PS2_KBD_DATA  (PS/2 DATA, CLK musi być GP20+1)
//   GP21 ──► pin 6   ── PS2_KBD_CLK   (PS/2 CLK)
//   GND  ──► GND
//   3V3  ──► 3V3     ── zasilanie PS/2 (breakout ma rezystory pull-up)

#include <string.h>
#include "pico/stdlib.h"
#include "pico/multicore.h"
#include "vga.h"      // codaris/picovga-cmake
#include "ps2kbd.h"   // lurk101/ps2kbd-lib

// ---------------------------------------------------------------------------
// PS/2 GPIO
// DATA i CLK muszą być na kolejnych GPIO (CLK = DATA+1)
// ---------------------------------------------------------------------------
#define PS2_DAT_GPIO 20u   // GP20 — DATA; CLK = GP21

// ---------------------------------------------------------------------------
// Framebuffer: 640×480, 1 bit/piksel (FORM_GRAPH1)
// Bit 7 (MSB) = lewy piksel w bajcie
// Stride = 80 bajtów/linię, rozmiar = 38 400 B
// ---------------------------------------------------------------------------
#define FB_WIDTH   640u
#define FB_HEIGHT  480u
#define FB_STRIDE  (FB_WIDTH / 8u)

static uint8_t framebuf[FB_HEIGHT * FB_STRIDE];

// ---------------------------------------------------------------------------
// Czcionka 8×8 — public domain (IBM VGA, via dhepper/font8x8)
// Indeks = kod ASCII (0x00–0x7F), bit 7 (MSB) = lewy piksel wiersza.
// ---------------------------------------------------------------------------
// clang-format off
static const uint8_t font8x8[128][8] = {
    /* 0x00–0x1F kontrolne (puste) */
    {0},{0},{0},{0},{0},{0},{0},{0}, {0},{0},{0},{0},{0},{0},{0},{0},
    {0},{0},{0},{0},{0},{0},{0},{0}, {0},{0},{0},{0},{0},{0},{0},{0},
    /* 0x20–0x7F drukowane */
    {0x00,0x00,0x00,0x00,0x00,0x00,0x00,0x00}, /* 0x20   */
    {0x18,0x3C,0x3C,0x18,0x18,0x00,0x18,0x00}, /* 0x21 ! */
    {0x36,0x36,0x00,0x00,0x00,0x00,0x00,0x00}, /* 0x22 " */
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    {0x00,0x00,0x00,0x00,0x00,0x00,0x00,0x00}, /* 0x7F DEL */
};
// clang-format on

// ---------------------------------------------------------------------------
// Framebuffer — operacje pikselowe
// ---------------------------------------------------------------------------
static inline void fb_set_pixel(uint32_t x, uint32_t y, bool on) {
    if (x >= FB_WIDTH || y >= FB_HEIGHT) return;
    uint8_t *b = &framebuf[y * FB_STRIDE + x / 8u];
    uint8_t  m = 0x80u >> (x % 8u);
    if (on) *b |= m;
    else    *b &= ~m;
}

// ---------------------------------------------------------------------------
// Renderowanie tekstu 80×60 znaków (8×8 px / znak)
// ---------------------------------------------------------------------------
#define TEXT_COLS  (FB_WIDTH  / 8u)   // 80
#define TEXT_ROWS  (FB_HEIGHT / 8u)   // 60

static uint32_t cur_col = 0;
static uint32_t cur_row = 0;

static void fb_draw_char(uint32_t col, uint32_t row, char c) {
    if ((uint8_t)c >= 128u) return;
    const uint8_t *glyph = font8x8[(uint8_t)c];
    uint32_t px = col * 8u;
    uint32_t py = row * 8u;
    for (uint32_t r = 0; r < 8u; r++) {
        uint8_t bits = glyph[r];
        for (uint32_t p = 0u; p < 8u; p++)
            fb_set_pixel(px + p, py + r, (bits >> (7u - p)) & 1u);
    }
}

static void fb_scroll_up(void) {
    memmove(&framebuf[0],
            &framebuf[8u * FB_STRIDE],
            (TEXT_ROWS - 1u) * 8u * FB_STRIDE);
    memset(&framebuf[(TEXT_ROWS - 1u) * 8u * FB_STRIDE], 0, 8u * FB_STRIDE);
}

static void fb_put_char(char c) {
    if (c == '\n') {
        cur_col = 0;
        cur_row++;
    } else if (c == '\r') {
        cur_col = 0;
    } else if (c == '\b') {
        if (cur_col > 0) {
            cur_col--;
            fb_draw_char(cur_col, cur_row, ' ');
        }
    } else {
        fb_draw_char(cur_col, cur_row, c);
        cur_col++;
        if (cur_col >= TEXT_COLS) {
            cur_col = 0;
            cur_row++;
        }
    }
    if (cur_row >= TEXT_ROWS) {
        fb_scroll_up();
        cur_row = TEXT_ROWS - 1u;
    }
}

static void fb_puts(const char *s) {
    while (*s) fb_put_char(*s++);
}

// ---------------------------------------------------------------------------
// Core 1 — sterownik PicoVGA (blokuje, generuje VGA przez PIO0 + DMA)
// ---------------------------------------------------------------------------
static void core1_entry(void) {
    VgaCore();
}

// ---------------------------------------------------------------------------
// Main
// ---------------------------------------------------------------------------
int main(void) {
    stdio_init_all();

    // Wyczyść framebuffer przed startem wideo
    memset(framebuf, 0, sizeof(framebuf));

    // Uruchom sterownik VGA na core 1 (musi być przed Video())
    multicore_launch_core1(core1_entry);

    // Inicjalizacja PicoVGA (PIO0):
    //   DEV_VGA     — wyjście VGA (GP0–GP9)
    //   RES_VGA     — 640×480 @ 60 Hz
    //   FORM_GRAPH1 — format 1bpp (MSB = lewy piksel)
    Video(DEV_VGA, RES_VGA, FORM_GRAPH1, framebuf, NULL);

    // Inicjalizacja klawiatury PS/2 (PIO1, GP20=DATA, GP21=CLK)
    kbd_init(1, PS2_DAT_GPIO);

    fb_puts("RPiPico2DisplayVGA\n");
    fb_puts("PS/2 keyboard ready. Type below:\n");
    fb_puts("> ");

    while (true) {
        if (kbd_ready()) {
            char c = kbd_getc();
            // Echo na monitor VGA
            fb_put_char(c);
            // Echo przez USB serial (minicom/screen na /dev/ttyACM*)
            putchar_raw(c);
            // Po Enter — nowa linia z promptem
            if (c == '\n') fb_puts("> ");
        }
    }
}
