// Wygenerowane przez tools/gen_wasm_fixtures.py — nie edytuj ręcznie.
//
// Moduły WebAssembly dla testów silnika WASM, wpisane jako bajty, żeby
// `make` w test/ nie wymagał toolchaina — ta sama zasada, co przy
// test/arduino_stub/.

/** setup/loop przelaczajace pin przez import gpio_toggle (98 B) */
const unsigned char kWasmCounter[] = {
    0x00, 0x61, 0x73, 0x6D, 0x01, 0x00, 0x00, 0x00, 0x01, 0x09, 0x02, 0x60,
    0x00, 0x00, 0x60, 0x01, 0x7F, 0x01, 0x7F, 0x02, 0x15, 0x01, 0x05, 0x68,
    0x79, 0x64, 0x72, 0x61, 0x0B, 0x67, 0x70, 0x69, 0x6F, 0x5F, 0x74, 0x6F,
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    0x1A, 0x0B,
};

/** loop() z petla bez wyjscia — sprawdzian budzetu (53 B) */
const unsigned char kWasmInfiniteLoop[] = {
    0x00, 0x61, 0x73, 0x6D, 0x01, 0x00, 0x00, 0x00, 0x01, 0x04, 0x01, 0x60,
    0x00, 0x00, 0x03, 0x02, 0x01, 0x00, 0x05, 0x03, 0x01, 0x00, 0x01, 0x07,
    0x11, 0x02, 0x04, 0x6C, 0x6F, 0x6F, 0x70, 0x00, 0x00, 0x06, 0x6D, 0x65,
    0x6D, 0x6F, 0x72, 0x79, 0x02, 0x00, 0x0A, 0x09, 0x01, 0x07, 0x00, 0x03,
    0x40, 0x0C, 0x00, 0x0B, 0x0B,
};

/** loop() z petla o dziesieciu obrotach — miesci sie w budzecie (74 B) */
const unsigned char kWasmBoundedLoop[] = {
    0x00, 0x61, 0x73, 0x6D, 0x01, 0x00, 0x00, 0x00, 0x01, 0x04, 0x01, 0x60,
    0x00, 0x00, 0x03, 0x02, 0x01, 0x00, 0x05, 0x03, 0x01, 0x00, 0x01, 0x07,
    0x11, 0x02, 0x04, 0x6C, 0x6F, 0x6F, 0x70, 0x00, 0x00, 0x06, 0x6D, 0x65,
    0x6D, 0x6F, 0x72, 0x79, 0x02, 0x00, 0x0A, 0x1E, 0x01, 0x1C, 0x01, 0x01,
    0x7F, 0x41, 0x00, 0x21, 0x00, 0x02, 0x40, 0x03, 0x40, 0x20, 0x00, 0x41,
    0x01, 0x6A, 0x21, 0x00, 0x20, 0x00, 0x41, 0x0A, 0x48, 0x0D, 0x00, 0x0B,
    0x0B, 0x0B,
};

/** modul z samym setup(), bez loop() (49 B) */
const unsigned char kWasmNoLoop[] = {
    0x00, 0x61, 0x73, 0x6D, 0x01, 0x00, 0x00, 0x00, 0x01, 0x04, 0x01, 0x60,
    0x00, 0x00, 0x03, 0x02, 0x01, 0x00, 0x05, 0x03, 0x01, 0x00, 0x01, 0x07,
    0x12, 0x02, 0x05, 0x73, 0x65, 0x74, 0x75, 0x70, 0x00, 0x00, 0x06, 0x6D,
    0x65, 0x6D, 0x6F, 0x72, 0x79, 0x02, 0x00, 0x0A, 0x04, 0x01, 0x02, 0x00,
    0x0B,
};

/** modul zadajacy importu spoza wystawionej powierzchni (78 B) */
const unsigned char kWasmMissingImport[] = {
    0x00, 0x61, 0x73, 0x6D, 0x01, 0x00, 0x00, 0x00, 0x01, 0x09, 0x02, 0x60,
    0x00, 0x00, 0x60, 0x01, 0x7F, 0x01, 0x7F, 0x02, 0x12, 0x01, 0x05, 0x68,
    0x79, 0x64, 0x72, 0x61, 0x08, 0x69, 0x32, 0x63, 0x5F, 0x73, 0x63, 0x61,
    0x6E, 0x00, 0x01, 0x03, 0x02, 0x01, 0x00, 0x05, 0x03, 0x01, 0x00, 0x01,
    0x07, 0x11, 0x02, 0x04, 0x6C, 0x6F, 0x6F, 0x70, 0x00, 0x01, 0x06, 0x6D,
    0x65, 0x6D, 0x6F, 0x72, 0x79, 0x02, 0x00, 0x0A, 0x09, 0x01, 0x07, 0x00,
    0x41, 0x00, 0x10, 0x00, 0x1A, 0x0B,
};

/** publikuje zdarzenie i odbiera je przez eksport on_event (132 B) */
const unsigned char kWasmEventEcho[] = {
    0x00, 0x61, 0x73, 0x6D, 0x01, 0x00, 0x00, 0x00, 0x01, 0x11, 0x03, 0x60,
    0x00, 0x00, 0x60, 0x04, 0x7F, 0x7F, 0x7D, 0x7F, 0x00, 0x60, 0x03, 0x7F,
    0x7D, 0x7F, 0x00, 0x02, 0x14, 0x01, 0x05, 0x68, 0x79, 0x64, 0x72, 0x61,
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    0x0B, 0x01, 0x00, 0x41, 0x10, 0x0B, 0x05, 0x61, 0x6C, 0x61, 0x72, 0x6D,
};

